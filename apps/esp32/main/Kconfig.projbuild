## apps/esp32/main/Kconfig.projbuild
```kconfig
menu "ESP32-C5 CSI sensing"

    config CSI_SENSOR_ENABLED
        bool
        default y
        select ESP_WIFI_CSI_ENABLED

    config CSI_WIFI_SSID
        string "2.4 GHz Wi-Fi SSID"
        default ""

    config CSI_WIFI_PASSWORD
        string "Wi-Fi password"
        default ""

    config CSI_WIFI_MAXIMUM_RETRY
        int "Maximum connection retries"
        range 1 100
        default 10

    config CSI_PING_RATE_HZ
        int "Router ping rate (Hz)"
        range 10 100
        default 100

    config CSI_PING_DATA_SIZE
        int "ICMP payload size (bytes)"
        range 16 512
        default 64

    config CSI_BLE_REQUIRE_ENCRYPTION
        bool "Require encrypted BLE telemetry connections"
        default n
        help
            Enable for production deployments after a physical pairing policy is
            available. Development builds leave this disabled for Web Bluetooth
            interoperability.

endmenu
```
